#include <U8g2lib.h>
#include <avr/pgmspace.h>
#include <EEPROM.h>
#include <stdint.h>

#define EEPROM_SIGNATURE 0x42C4A1

// U8GLIB_SH1106_128X64 u8g(13, 11, 10, 9); // SCK = 13, MOSI = 11, CS = 10, A0 = 9
U8G2_SSD1306_128X64_NONAME_1_HW_I2C u8g(U8G2_R0, /* reset=*/ U8X8_PIN_NONE);

/*
= OLED screen =
GND  = GND (5V)
VCC  = 5V
SCL  = A5
SDA  = A4

= Button =

GND = GND (3V)
VCC = 3V
SIG = 2

= Text =

Line: 21 chars
5 lines
Y Pos for lines: 8 / 21 / 34 / 47 / 60
*/

int gameMode = 99;
char scoreString[9];
const char* textToDisplay = "";
int buttonState = 0;
unsigned long frameCounter = 0;
int animationStep = 1;
int animationStepMax = 4;
const byte ButtonPin = 2;
const unsigned long DebounceTime = 10;
boolean ButtonWasPressed = false;
unsigned long ButtonStateChangeTime = 0; // Debounce timer
int currentIcon = 0;
int cleanCounter = 0;
int cleanSequence = 0;
int gameCounter = 0;
int gameSequence = 0;
long gamePick = 0;
int lessonSequence = 0;
int snailCounter = 0;
int kokoXPos = 0;
long randomQuote = 0;
int feedSequence = 0;
int feedCounter = 0;
int selectedFood = 0;
int superHappyCounter = 0;
long randomVisit = 0;
long randomVisitTrigger = 500;
int randomVisitSequence = 0;
int randomVisitCounter = 0;
long randomGameIconXPos = 0;
long randomFoodType = 0;
int gameIconXPos = 0;
int slotReel[3];        // final icons for left, center, right
int spinIcon[3];        // currently displayed while spinning
int currentReel = 0;    // which reel is spinning (0-2)
int versionCounter = 0;
int shortWait = 200;
int mediumWait = 400;
int longWait = 800;
int mysteryFood = 0;
unsigned long lastSaveTime = 0;
const unsigned long saveInterval = 300000; // 5 minutes en millisecondes
unsigned long lastFrameTime = 0;
// const unsigned long frameInterval = 50; // 50 ms
const unsigned long frameInterval = 100; // 100 ms

// Cat status variables
// Status metrics
// 0 = depleted, 1 = low, 2 = average, 3 = full
struct CatStats {
  uint8_t hunger;
  uint8_t hygiene;
  uint8_t education;
  uint8_t entertainment;
  uint16_t hungerStep;
  uint16_t hygieneStep;
  uint16_t educationStep;
  uint16_t entertainmentStep;
  uint32_t score;
  int strawberryFoodStock;
  int appleFoodStock;
  int grapeFoodStock;
  int milkFoodStock;
  int orangeFoodStock;
};

CatStats cat;

// Tracking status checks
unsigned long lastCatHungerCheck = 0;
unsigned long lastCatHygieneCheck = 0;
unsigned long lastCatEducationCheck = 0;
unsigned long lastCatEntertainmentCheck = 0;

#define door_28x30_width 28
#define door_28x30_height 30
static const unsigned char door_28x30_bits[] PROGMEM = {
   0xff, 0xff, 0xff, 0x0f, 0xff, 0xff, 0xff, 0x0f, 0x03, 0x00, 0x00, 0x0c,
   0x03, 0x00, 0x00, 0x0c, 0x03, 0x00, 0x00, 0x0c, 0x03, 0x00, 0x00, 0x0c,
   0xf3, 0xff, 0xff, 0x0c, 0xf3, 0xff, 0xff, 0x0c, 0xf3, 0x00, 0x30, 0x0c,
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   0xf3, 0xff, 0x3f, 0x0c, 0xf3, 0xff, 0xff, 0x0c, 0xf3, 0xff, 0xff, 0x0c };

#define coco_cake_28x32_width 28
#define coco_cake_28x32_height 32
static const unsigned char coco_cake_28x32_bits[] PROGMEM = {
   0x00, 0xf0, 0x03, 0x00, 0x00, 0xf0, 0x03, 0x00, 0x00, 0xfc, 0x0f, 0x00,
   0x00, 0xfc, 0x0f, 0x00, 0xff, 0xfc, 0xcf, 0x0c, 0xff, 0xfc, 0xcf, 0x0c,
   0xfc, 0xf0, 0xc3, 0x0c, 0xfc, 0xf0, 0xc3, 0x0c, 0xf0, 0x00, 0xc0, 0x0c,
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   0x00, 0x00, 0x33, 0x00, 0x00, 0x00, 0x33, 0x00 };

#define matcha_30x32_width 30
#define matcha_30x32_height 32
static const unsigned char matcha_30x32_bits[] PROGMEM = {
   0x00, 0x00, 0x03, 0x00, 0x00, 0x00, 0x03, 0x00, 0x00, 0x00, 0x0c, 0x00,
   0x00, 0x00, 0x0c, 0x00, 0x00, 0x3c, 0x0c, 0x00, 0x00, 0x3c, 0x0c, 0x00,
   0x00, 0xc3, 0x03, 0x00, 0x00, 0xc3, 0x03, 0x00, 0x00, 0x03, 0x00, 0x00,
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   0xf0, 0xff, 0x0f, 0x00, 0xf0, 0xff, 0x0f, 0x00 };

#define cindy_28x26_width 28
#define cindy_28x26_height 26
static const unsigned char cindy_28x26_bits[] PROGMEM = {
   0xcf, 0xff, 0x3f, 0x0f, 0xcf, 0xff, 0x3f, 0x0f, 0xf3, 0xff, 0xff, 0x0c,
   0xf3, 0xff, 0xff, 0x0c, 0x3c, 0x3f, 0xff, 0x03, 0x3c, 0x3f, 0xff, 0x03,
   0x3c, 0x3f, 0xff, 0x03, 0x3c, 0x3f, 0xff, 0x03, 0xfc, 0xff, 0xff, 0x03,
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   0xc0, 0x03, 0x3c, 0x00, 0xc0, 0x03, 0x3c, 0x00 };

#define super_happy_28x28_width 28
#define super_happy_28x28_height 28
static const unsigned char super_happy_28x28_bits[] PROGMEM = {
   0xc0, 0xff, 0x3f, 0x00, 0xc0, 0xff, 0x3f, 0x00, 0xf0, 0xff, 0xff, 0x00,
   0xf0, 0xff, 0xff, 0x00, 0xfc, 0xff, 0xff, 0x03, 0xfc, 0xff, 0xff, 0x03,
   0xff, 0xfc, 0xf3, 0x0f, 0xff, 0xfc, 0xf3, 0x0f, 0xff, 0xfc, 0xf3, 0x0f,
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   0xc0, 0xff, 0x3f, 0x00 };

#define koko_le_snail_26x22_width 26
#define koko_le_snail_26x22_height 22
static const unsigned char koko_le_snail_26x22_bits[] PROGMEM = {
   0x3c, 0xf0, 0x00, 0x00, 0x3c, 0xf0, 0x00, 0x00, 0xff, 0xfc, 0x03, 0x00,
   0xff, 0xfc, 0x03, 0x00, 0xcf, 0xcc, 0x03, 0x00, 0xcf, 0xcc, 0x03, 0x00,
   0x3c, 0xf3, 0x00, 0x00, 0x3c, 0xf3, 0x00, 0x00, 0xc0, 0x0f, 0xfc, 0x00,
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   0xc0, 0xff, 0xff, 0x00 };

#define orange_28x28_width 28
#define orange_28x28_height 28
static const unsigned char orange_28x28_bits[] PROGMEM = {
   0x00, 0x00, 0x00, 0x00, 0x00, 0x00, 0x00, 0x00, 0x00, 0x00, 0x00, 0x00,
   0x3c, 0x00, 0xc0, 0x03, 0x3c, 0x00, 0xc0, 0x03, 0xcf, 0x03, 0xf0, 0x0c,
   0xcf, 0x03, 0xf0, 0x0c, 0xcf, 0xff, 0xff, 0x0c, 0xcf, 0xff, 0xff, 0x0c,
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   0x00, 0x00, 0x00, 0x00 };

#define milk_28x28_width 28
#define milk_28x28_height 28
static const unsigned char milk_28x28_bits[] PROGMEM = {
   0xc0, 0xff, 0x3f, 0x00, 0xc0, 0xff, 0x3f, 0x00, 0x30, 0x00, 0xc0, 0x00,
   0x30, 0x00, 0xc0, 0x00, 0xf0, 0xff, 0xff, 0x00, 0xf0, 0xff, 0xff, 0x00,
   0x0c, 0x00, 0x00, 0x03, 0x0c, 0x00, 0x00, 0x03, 0x03, 0x00, 0x00, 0x0c,
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   0xff, 0xff, 0xff, 0x0f };

#define grape_28x28_width 28
#define grape_28x28_height 28
static const unsigned char grape_28x28_bits[] PROGMEM = {
   0x00, 0x0c, 0x00, 0x00, 0x00, 0x0c, 0x00, 0x00, 0x00, 0x30, 0x00, 0x00,
   0x00, 0x30, 0x00, 0x00, 0x00, 0x00, 0x00, 0x00, 0x00, 0x00, 0x00, 0x00,
   0x3c, 0xfc, 0xc0, 0x03, 0x3c, 0xfc, 0xc0, 0x03, 0x33, 0xcf, 0x33, 0x0f,
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   0x00, 0xf0, 0x00, 0x00 };

#define strawberry_28x28_width 28
#define strawberry_28x28_height 28
static const unsigned char strawberry_28x28_bits[] PROGMEM = {
   0x00, 0x00, 0x00, 0x00, 0x00, 0x00, 0x00, 0x00, 0xc0, 0xf3, 0x3c, 0x00,
   0xc0, 0xf3, 0x3c, 0x00, 0xc0, 0x0f, 0x3f, 0x00, 0xc0, 0x0f, 0x3f, 0x00,
   0x00, 0xf0, 0x00, 0x00, 0x00, 0xf0, 0x00, 0x00, 0xf0, 0xfc, 0xf3, 0x00,
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   0x00, 0x00, 0x00, 0x00 };

#define apple_28x28_width 28
#define apple_28x28_height 28
static const unsigned char apple_28x28_bits[] PROGMEM = {
   0xf8, 0x07, 0x00, 0x00, 0xf8, 0x07, 0x00, 0x00, 0xf8, 0x1f, 0x00, 0x00,
   0xf8, 0x1f, 0x00, 0x00, 0xe0, 0x67, 0x00, 0x00, 0xe0, 0x67, 0x00, 0x00,
   0x00, 0x60, 0x7e, 0x00, 0x00, 0x60, 0x7e, 0x00, 0xf8, 0x61, 0xf8, 0x01,
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   0x80, 0xff, 0x1f, 0x00 };

#define bar_28x28_width 28
#define bar_28x28_height 28
static const unsigned char bar_28x28_bits[] PROGMEM = {
   0x00, 0x00, 0x00, 0x00, 0xfc, 0xff, 0xff, 0x03, 0xfc, 0xff, 0xff, 0x03,
   0x03, 0x00, 0x00, 0x0c, 0xff, 0xff, 0xff, 0x0f, 0xff, 0xff, 0xff, 0x0f,
   0x00, 0x00, 0x00, 0x00, 0x00, 0x00, 0x00, 0x00, 0x7c, 0xf0, 0xf8, 0x00,
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   0x00, 0x00, 0x00, 0x00 };

#define casino_frame_40x40_width 40
#define casino_frame_40x40_height 40
static const unsigned char casino_frame_40x40_bits[] PROGMEM = {
   0x7e, 0xfe, 0xff, 0x7f, 0x7e, 0x71, 0xfe, 0xff, 0x7f, 0x8e, 0x71, 0xfe,
   0xff, 0x7f, 0x8e, 0x71, 0xfe, 0xff, 0x7f, 0x8e, 0x0f, 0x00, 0x00, 0x00,
   0xf0, 0x0f, 0x00, 0x00, 0x00, 0xf0, 0x0f, 0x00, 0x00, 0x00, 0xf0, 0x00,
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   0xff, 0x7f, 0x8e, 0x7e, 0xfe, 0xff, 0x7f, 0x7e };

#define speech_bubble_56x48_width 56
#define speech_bubble_56x48_height 48
static const unsigned char speech_bubble_56x48_bits[] PROGMEM = {
   0x00, 0xf0, 0xff, 0xff, 0xff, 0xff, 0x0f, 0x00, 0xf0, 0xff, 0xff, 0xff,
   0xff, 0x0f, 0x00, 0xf0, 0xff, 0xff, 0xff, 0xff, 0x0f, 0x00, 0x70, 0x00,
   0x00, 0x00, 0x00, 0x0e, 0x00, 0x7f, 0x00, 0x00, 0x00, 0x00, 0xfe, 0x00,
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   0xff, 0xff, 0xff, 0xff, 0x0f, 0x00, 0xf0, 0xff, 0xff, 0xff, 0xff, 0x0f };

#define happy_cat_28x28_width 28
#define happy_cat_28x28_height 28
static const unsigned char happy_cat_28x28_bits[] PROGMEM = {
   0xc0, 0xff, 0x3f, 0x00, 0xc0, 0xff, 0x3f, 0x00, 0xf0, 0xff, 0xff, 0x00,
   0xf0, 0xff, 0xff, 0x00, 0xfc, 0xff, 0xff, 0x03, 0xfc, 0xff, 0xff, 0x03,
   0xff, 0xff, 0xff, 0x0f, 0xff, 0xff, 0xff, 0x0f, 0xff, 0xfc, 0xf3, 0x0f,
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   0xc0, 0xff, 0x3f, 0x00 };

#define ghost_28x28_width 28
#define ghost_28x28_height 28
static const unsigned char ghost_28x28_bits[] PROGMEM = {
   0x00, 0xfc, 0x3f, 0x00, 0x00, 0xfc, 0x3f, 0x00, 0x00, 0xff, 0xff, 0x00,
   0x00, 0xff, 0xff, 0x00, 0xc0, 0xff, 0xff, 0x03, 0xc0, 0xff, 0xff, 0x03,
   0xc0, 0x0f, 0x0f, 0x03, 0xc0, 0x0f, 0x0f, 0x03, 0xf0, 0x0f, 0x0f, 0x0f,
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   0x00, 0x0f, 0x0f, 0x00 };

#define play_32x20_width 32
#define play_32x20_height 20
static const unsigned char play_32x20_bits[] PROGMEM = {
   0x30, 0xff, 0xff, 0x0f, 0x30, 0xff, 0xff, 0x0f, 0xcc, 0xff, 0xff, 0x3f,
   0xcc, 0xff, 0xff, 0x3f, 0xf3, 0xff, 0xff, 0xff, 0xf3, 0xff, 0xff, 0xff,
   0xf3, 0xf3, 0x3f, 0xf3, 0xf3, 0xf3, 0x3f, 0xf3, 0xf3, 0xc0, 0xff, 0xff,
   0xf3, 0xc0, 0xff, 0xff, 0xf3, 0xf3, 0x30, 0xf3, 0xf3, 0xf3, 0x30, 0xf3,
   0xf3, 0xff, 0xff, 0xff, 0xf3, 0xff, 0xff, 0xff, 0xf3, 0xff, 0xff, 0xff,
   0xf3, 0xff, 0xff, 0xff, 0xcc, 0xff, 0xf3, 0x3f, 0xcc, 0xff, 0xf3, 0x3f,
   0x30, 0x3f, 0xcc, 0x0f, 0x30, 0x3f, 0xcc, 0x0f };

#define study_26x28_width 26
#define study_26x28_height 28
static const unsigned char study_26x28_bits[] PROGMEM = {
   0xfc, 0xff, 0xff, 0x03, 0xfc, 0xff, 0xff, 0x03, 0x3f, 0xff, 0xf3, 0x03,
   0x3f, 0xff, 0xf3, 0x03, 0xcf, 0xff, 0xcf, 0x03, 0xcf, 0xff, 0xcf, 0x03,
   0xcf, 0x03, 0xcf, 0x03, 0xcf, 0x03, 0xcf, 0x03, 0xcf, 0xff, 0xcf, 0x03,
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   0xfc, 0xff, 0xff, 0x03 };

#define bubbles_30x30_width 30
#define bubbles_30x30_height 30
static const unsigned char bubbles_30x30_bits[] PROGMEM = {
   0xf0, 0x0f, 0x00, 0x00, 0xf0, 0x0f, 0x00, 0x00, 0x0c, 0x30, 0x00, 0x00,
   0x0c, 0x30, 0x00, 0x00, 0xf3, 0xc0, 0x00, 0x00, 0xf3, 0xc0, 0x00, 0x00,
   0xf3, 0xc0, 0x00, 0x00, 0xf3, 0xc0, 0x00, 0x00, 0x03, 0xcc, 0x00, 0x00,
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   0x30, 0x30, 0x00, 0x00, 0xc0, 0x0f, 0x00, 0x00, 0xc0, 0x0f, 0x00, 0x00 };

#define pizza_26x28_width 26
#define pizza_26x28_height 28
static const unsigned char pizza_26x28_bits[] PROGMEM = {
   0xf0, 0xff, 0x3f, 0x00, 0xf0, 0xff, 0x3f, 0x00, 0xfc, 0xff, 0xff, 0x00,
   0xfc, 0xff, 0xff, 0x00, 0x3f, 0x00, 0xf0, 0x03, 0x3f, 0x00, 0xf0, 0x03,
   0xcf, 0xf3, 0xcc, 0x03, 0xcf, 0xf3, 0xcc, 0x03, 0xf0, 0x3f, 0x30, 0x00,
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   0x00, 0x0c, 0x00, 0x00 };

#define cat_sitting_upscaled4x_001_width 48
#define cat_sitting_upscaled4x_001_height 48
static const unsigned char cat_sitting_upscaled4x_001_bits[] PROGMEM = {
   0x00, 0x00, 0xf0, 0x0f, 0x00, 0xff, 0x00, 0x00, 0xf0, 0x0f, 0x00, 0xff,
   0x00, 0x00, 0xf0, 0x0f, 0x00, 0xff, 0x00, 0x00, 0xf0, 0x0f, 0x00, 0xff,
   0x00, 0x00, 0xf0, 0xf0, 0xff, 0xf0, 0x00, 0x00, 0xf0, 0xf0, 0xff, 0xf0,
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   0xff, 0xff, 0xff, 0xff, 0xff, 0xff, 0xff, 0xff, 0xff, 0xff, 0xff, 0xff };

#define cat_sitting_upscaled4x_002_width 48
#define cat_sitting_upscaled4x_002_height 48
static const unsigned char cat_sitting_upscaled4x_002_bits[] PROGMEM = {
   0x00, 0x00, 0xf0, 0x0f, 0x00, 0xff, 0x00, 0x00, 0xf0, 0x0f, 0x00, 0xff,
   0x00, 0x00, 0xf0, 0x0f, 0x00, 0xff, 0x00, 0x00, 0xf0, 0x0f, 0x00, 0xff,
   0x00, 0x00, 0xf0, 0xf0, 0xff, 0xf0, 0x00, 0x00, 0xf0, 0xf0, 0xff, 0xf0,
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   0xff, 0xf0, 0xff, 0xff, 0xff, 0xff, 0xff, 0xf0, 0xff, 0xff, 0xff, 0xff };

#define cat_sitting_upscaled4x_003_width 48
#define cat_sitting_upscaled4x_003_height 48
static const unsigned char cat_sitting_upscaled4x_003_bits[] PROGMEM = {
   0x00, 0x00, 0xf0, 0x0f, 0x00, 0xff, 0x00, 0x00, 0xf0, 0x0f, 0x00, 0xff,
   0x00, 0x00, 0xf0, 0x0f, 0x00, 0xff, 0x00, 0x00, 0xf0, 0x0f, 0x00, 0xff,
   0x00, 0x00, 0xf0, 0xf0, 0xff, 0xf0, 0x00, 0x00, 0xf0, 0xf0, 0xff, 0xf0,
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   0x00, 0xf0, 0xff, 0xff, 0xff, 0xff, 0x00, 0xf0, 0xff, 0xff, 0xff, 0xff };

#define cat_sitting_upscaled4x_004_width 48
#define cat_sitting_upscaled4x_004_height 48
static const unsigned char cat_sitting_upscaled4x_004_bits[] PROGMEM = {
   0x00, 0x00, 0xf0, 0x0f, 0x00, 0xff, 0x00, 0x00, 0xf0, 0x0f, 0x00, 0xff,
   0x00, 0x00, 0xf0, 0x0f, 0x00, 0xff, 0x00, 0x00, 0xf0, 0x0f, 0x00, 0xff,
   0x00, 0x00, 0xf0, 0xf0, 0xff, 0xf0, 0x00, 0x00, 0xf0, 0xf0, 0xff, 0xf0,
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   0x00, 0xff, 0xff, 0xff, 0xff, 0xff, 0x00, 0xff, 0xff, 0xff, 0xff, 0xff };

#define cat_sitting_upscaled4x_006_width 48
#define cat_sitting_upscaled4x_006_height 48
static const unsigned char cat_sitting_upscaled4x_006_bits[] PROGMEM = {
   0x00, 0x00, 0x00, 0xff, 0x00, 0xff, 0x00, 0x00, 0x00, 0xff, 0x00, 0xff,
   0x00, 0x00, 0x00, 0xff, 0x00, 0xff, 0x00, 0x00, 0x00, 0xff, 0x00, 0xff,
   0x00, 0x00, 0x00, 0x0f, 0xff, 0xf0, 0x00, 0x00, 0x00, 0x0f, 0xff, 0xf0,
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   0xff, 0xf0, 0xff, 0xff, 0xff, 0xff, 0xff, 0xf0, 0xff, 0xff, 0xff, 0xff };

#define cat_sitting_upscaled4x_007_width 48
#define cat_sitting_upscaled4x_007_height 48
static const unsigned char cat_sitting_upscaled4x_007_bits[] PROGMEM = {
   0x00, 0x00, 0x00, 0xff, 0x00, 0xff, 0x00, 0x00, 0x00, 0xff, 0x00, 0xff,
   0x00, 0x00, 0x00, 0xff, 0x00, 0xff, 0x00, 0x00, 0x00, 0xff, 0x00, 0xff,
   0x00, 0x00, 0x00, 0x0f, 0xff, 0xf0, 0x00, 0x00, 0x00, 0x0f, 0xff, 0xf0,
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   0x00, 0xf0, 0xff, 0xff, 0xff, 0xff, 0x00, 0xf0, 0xff, 0xff, 0xff, 0xff };

void saveStatsToEEPROM() {
  uint32_t signature = EEPROM_SIGNATURE;
  EEPROM.put(0, signature);
  EEPROM.put(sizeof(signature), cat);
  Serial.println(F("Stats saved to EEPROM"));
}

void loadStatsFromEEPROM() {
  uint32_t signature = 0;
  EEPROM.get(0, signature);

  if (signature == EEPROM_SIGNATURE) {
    EEPROM.get(sizeof(signature), cat);
    Serial.println(F("Stats loaded from EEPROM"));
    Serial.print(F("cat.hunger: "));
    Serial.println(cat.hunger);
    Serial.print(F("cat.hygiene: "));
    Serial.println(cat.hygiene);
    Serial.print(F("cat.education: "));
    Serial.println(cat.education);
    Serial.print(F("cat.entertainment: "));
    Serial.println(cat.entertainment);
    Serial.print(F("cat.score: "));
    Serial.println(cat.score);
  } else {
    Serial.println(F("Empty or invalid EEPROM"));
  }
}

/*
void foodStock() {
  u8g.drawLine(0, 8, 127, 8);
  u8g.drawLine(0, 56, 127, 56);
  u8g.setFont(u8g_font_baby);
  u8g.drawXBMP(50, 24, strawberry_28x28_width, strawberry_28x28_height, strawberry_28x28_bits);
  u8g.drawStr(10, 60, cat.strawberryFoodStock);
  u8g.drawXBMP(50, 14, grape_28x28_width, grape_28x28_height, grape_28x28_bits);
  u8g.drawStr(10, 60, cat.grapeFoodStock);
  u8g.drawXBMP(50, 14, milk_28x28_width, milk_28x28_height, milk_28x28_bits);
  u8g.drawStr(10, 60, cat.milkFoodStock);
  u8g.drawXBMP(50, 14, orange_28x28_width, orange_28x28_height, orange_28x28_bits);
  u8g.drawStr(10, 60, cat.orangeFoodStock);
  u8g.drawXBMP(50, 14, apple_28x28_width, apple_28x28_height, apple_28x28_bits);
  u8g.drawStr(10, 60, cat.appleFoodStock);
}
*/

void checkButton() {
    unsigned long currentTime = millis();
    boolean buttonIsPressed = digitalRead(ButtonPin) == HIGH;  // Active HIGH

    // Check for button state change and do debounce
    if (buttonIsPressed != ButtonWasPressed &&
        currentTime - ButtonStateChangeTime > DebounceTime) {
        
        // Button state has changed
        ButtonWasPressed = buttonIsPressed;
        ButtonStateChangeTime = currentTime;

        if (!ButtonWasPressed) {
            // Button was just released
            if (gameMode == 0) {
                // Go to Save menu
                gameCounter = 0;
                gameSequence = 0;
                gameMode = 8;
            } else if (gameMode == 1) {
                // Do something only if cat needs something
                switch (currentIcon) {
                    case 2: // Play
                        gameCounter = 0;
                        gameSequence = 0;
                        currentReel = 0;
                        for (int i = 0; i < 3; i++) {
                            slotReel[i] = 0;
                            spinIcon[i] = 0;
                        }
                        gameMode = 6;
                        break;
                    case 3: // Study
                        randomQuote = random(1, 7);
                        kokoXPos = 128;
                        snailCounter = 0;
                        lessonSequence = 0;
                        gameMode = 4;
                        break;
                    case 5: // Clean
                        cleanSequence = 0;
                        cleanCounter = 0;
                        gameMode = 5;
                        break;
                    case 6: // Feed
                        selectedFood = 0;
                        feedSequence = 0;
                        feedCounter = 0;
                        gameMode = 2;
                        break;
                }
            } else if (gameMode == 5) {
                // Clean The Cat game
                if (cleanCounter < 0) {
                    cleanCounter = 0;
                }
                cleanCounter += 15;
            } else if (gameMode == 6) {
                // Catsino Deluxe game
                if (gameSequence == 0 && currentReel < 3) {
                    slotReel[currentReel] = spinIcon[currentReel];
                    currentReel++;
                    if (currentReel == 3) {
                        gameSequence = 2;
                        gameCounter = 0;
                        // Determine wins for Catsino Deluxe
                        /*
                        Serial.print(F("slotReel[0]:"));
                        Serial.println(slotReel[0]);
                        Serial.print(F("slotReel[1]:"));
                        Serial.println(slotReel[1]);
                        Serial.print(F("slotReel[2]:"));
                        Serial.println(slotReel[2]);
                        */
                        String superReel = String(slotReel[0]) + 
                                           String(slotReel[1]) + 
                                           String(slotReel[2]);
                        /*
                        Serial.print(F("superReel:"));
                        Serial.println(superReel);
                        */

                        // 3 Aligned = +1 of all
                        if (superReel == "000") {
                            // 3 x GHOST = Catastrophy
                            cat.strawberryFoodStock = 0;
                            cat.appleFoodStock = 0;
                            cat.grapeFoodStock = 0;
                            cat.milkFoodStock = 0;
                            cat.orangeFoodStock = 0;
                            cat.score = 0;
                            gamePick = 7;
                        } else if (superReel == "111") {
                            // 3 x BAR
                            cat.strawberryFoodStock += 30;
                            cat.appleFoodStock += 30;
                            cat.grapeFoodStock += 30;
                            cat.milkFoodStock += 30;
                            cat.orangeFoodStock += 30;
                            cat.score += 100000;
                            gamePick = 8;
                        } else if (superReel == "222") {
                            // 3 x STRAWBERRY
                            cat.strawberryFoodStock += 30;
                            cat.score += 10000;
                            gamePick = 9;
                        } else if (superReel == "333") {
                            cat.appleFoodStock += 30;
                            cat.score += 10000;
                            gamePick = 9;
                        } else if (superReel == "444") {
                            cat.grapeFoodStock += 30;
                            cat.score += 10000;
                            gamePick = 9;
                        } else if (superReel == "555") {
                            cat.milkFoodStock += 30;
                            cat.score += 10000;
                            gamePick = 9;
                        } else if (superReel == "666") {
                            cat.orangeFoodStock += 30;
                            cat.score += 10000;
                            gamePick = 9;
                        } else if (slotReel[0] == 0 && slotReel[1] == 0 || slotReel[1] == 0 && slotReel[2] == 0) {
                          // 2 x GHOST
                          gamePick = 0;
                        } else if (slotReel[0] == 0 || slotReel[1] == 0 || slotReel[2] == 0) {
                          // 1 x GHOST
                          gamePick = 0;
                        } else if (slotReel[0] == 1 && slotReel[1] == 1 || slotReel[1] == 1 && slotReel[2] == 1) {
                          // 2 x BAR
                          cat.strawberryFoodStock += 1;
                          cat.appleFoodStock += 1;
                          cat.grapeFoodStock += 1;
                          cat.milkFoodStock += 1;
                          cat.orangeFoodStock += 1;
                          cat.score += 500;
                          gamePick = 1;
                        } else if (slotReel[0] == 1 || slotReel[1] == 1 || slotReel[2] == 1) {
                          // 1 x BAR
                          cat.strawberryFoodStock += 1;
                          cat.appleFoodStock += 1;
                          cat.grapeFoodStock += 1;
                          cat.milkFoodStock += 1;
                          cat.orangeFoodStock += 1;
                          cat.score += 500;
                          gamePick = 1;
                        } else if (slotReel[0] > 1 && slotReel[1] > 1 &&  slotReel[2] > 1) {
                          gameSequence = 1;
                        } else {
                          gamePick = 0;
                        }
                    }
                } else if (gameSequence == 1) {
                  /*
                  Serial.print(F("gamePick set to"));
                  Serial.println(mysteryFood);
                  */
                  gamePick = mysteryFood;
                  gameSequence = 2;
                  gameCounter = 0;
                  switch (gamePick) {
                    case 2:
                      cat.strawberryFoodStock += 1;
                      break;
                    case 3:
                      cat.appleFoodStock += 1;
                      break;
                    case 4:
                      cat.grapeFoodStock += 1;
                      break;
                    case 5:
                      cat.milkFoodStock += 1;
                      break;
                    case 6:
                      cat.orangeFoodStock += 1;
                      break;
                  }
                  cat.score += 200;
                } else if (gameSequence == 2) {
                  if (gamePick > 0) {
                    superHappyCounter = 100;
                    cat.entertainment = 3;
                  }
                  gameMode = 0;
                  gameSequence = 0;
                  currentReel = 0;
                }
            } else if (gameMode == 7) {
                if (randomVisitSequence == 0) {
                    randomVisitSequence = 1;
                    randomVisitCounter = 0;
                }
            } else if (gameMode == 8) {
                // Save
                if (gameSequence == 0) {
                    gameSequence = 1;
                    gameCounter = 0;
                }
            } else if (gameMode == 99) {
                // Erase EEPROM signature only
                EEPROM.put(0, 0UL); // assuming signature is stored at address 0
                // Serial.println(F("EEPROM signature erased."));
            }
        }
    }
}


void drawDialog(int mode, const char* text, const char* helper, int icon) {
  // mode 0 = debrief (other modes to come)
  if (mode != 0) {
    return;
  }

  // u8g.drawLine(0, 8, 127, 8);
  u8g.drawLine(0, 56, 127, 56);

  // u8g.setFont(u8g_font_baby);
  u8g.setFont(u8g2_font_ncenB08_tr);
  int textX = (128 - u8g.getStrWidth(text)) / 2;
  if (textX < 0) {
    textX = 0;
  }
  u8g.drawStr(textX, 18, text);

  switch (icon) {
    case 0:
      u8g.drawXBMP(50, 18, ghost_28x28_width, ghost_28x28_height, ghost_28x28_bits);
      break;
    case 1:
      u8g.drawXBMP(50, 18, bar_28x28_width, bar_28x28_height, bar_28x28_bits);
      break;
    case 2:
      u8g.drawXBMP(50, 18, strawberry_28x28_width, strawberry_28x28_height, strawberry_28x28_bits);
      break;
    case 3:
      u8g.drawXBMP(50, 18, apple_28x28_width, apple_28x28_height, apple_28x28_bits);
      break;
    case 4:
      u8g.drawXBMP(50, 18, grape_28x28_width, grape_28x28_height, grape_28x28_bits);
      break;
    case 5:
      u8g.drawXBMP(50, 18, milk_28x28_width, milk_28x28_height, milk_28x28_bits);
      break;
    case 6:
      u8g.drawXBMP(50, 18, orange_28x28_width, orange_28x28_height, orange_28x28_bits);
      break;
    case 7:
      u8g.drawXBMP(50, 18, super_happy_28x28_width, super_happy_28x28_height, super_happy_28x28_bits);
      break;
  }

  u8g.setFont(u8g_font_baby);
  u8g.drawStr(10, 63, helper);
}

void setup(void) {
  // initialize the pushbutton pin as an input:
  u8g.begin();
  pinMode(ButtonPin, INPUT);
  // Better random numbers
  randomSeed(analogRead(A0));
  // Wait a bit
  delay(10);
  // flip screen, if required
  u8g.setDisplayRotation(U8G2_R2);  // optional rotation
  // Setting up cat stats
  cat.hunger = 0;
  cat.hygiene = 1;
  cat.education = 0;
  cat.entertainment = (uint8_t)random(1, 4);
  cat.hungerStep = (uint16_t)random(4000, 7000);
  // cat.hungerStep = 1;
  cat.hygieneStep = (uint16_t)random(9000, 19000);
  // cat.hygieneStep = 1;
  cat.educationStep = (uint16_t)random(400, 1500);
  // cat.educationStep = 3;
  cat.entertainmentStep = (uint16_t)random(300, 700);
  cat.strawberryFoodStock = 0;
  cat.appleFoodStock = 6;
  cat.grapeFoodStock = 0;
  cat.milkFoodStock = 0;
  cat.orangeFoodStock = 0;
  Serial.begin(9600);
  // Serial.println(F("---8<---"));
};

void loop(void) {
  checkButton();
  unsigned long currentTime = millis();
  if (currentTime - lastFrameTime >= frameInterval) {
    lastFrameTime = currentTime;
    frameCounter++;
    if (frameCounter > 4294967290) {
      frameCounter = 0;
      lastCatHungerCheck = 0;
      lastCatHygieneCheck = 0;
      lastCatEducationCheck = 0;
      lastCatEntertainmentCheck = 0;
    }
    animationStep += 1;
    if (animationStep>animationStepMax) {
      animationStep=1;
    }
  
    // Refresh cat statistics
    // Hunger
    if (frameCounter == lastCatHungerCheck + cat.hungerStep) {
      if (cat.hunger > 0) {
        cat.hunger -= 1;
      }
      lastCatHungerCheck = frameCounter;
    }
    // Hygiene
    if (frameCounter == lastCatHygieneCheck + cat.hygieneStep) {
      if (cat.hygiene > 0) {
        cat.hygiene -= 1;
      }
      lastCatHygieneCheck = frameCounter;
    }
    // Education
    if (frameCounter == lastCatEducationCheck + cat.educationStep) {
      if (cat.education < 3 && gameMode == 0) {
        // Time to study
        currentIcon = 3;
        gameMode = 1;
      }
      lastCatEducationCheck = frameCounter;
    }
    // Entertainment
    if (frameCounter == lastCatEntertainmentCheck + cat.entertainmentStep) {
      if (cat.entertainment > 0) {
        cat.entertainment -= 1;
      }
      lastCatEntertainmentCheck = frameCounter;
    }
  
    // Act on cat stats
    if (cat.hunger == 0 && gameMode == 0) {
      // Time to feed the cat
      currentIcon = 6;
      gameMode = 1;
      randomVisit = random(0, 3136);
      if (randomVisit<randomVisitTrigger && randomVisit % 2 == 0) {
        randomVisitSequence = 0;
        randomVisitCounter = 0;
        gameMode = 7;
        /*
        Serial.print(F("randomVisit: "));
        Serial.println(randomVisit);
        */
      }
    } else if (cat.hygiene==0 && gameMode == 0) {
      // Time to clean
      currentIcon = 5;
      gameMode = 1;
    } else if (cat.entertainment==0 && gameMode == 0) {
      // Time to play
      currentIcon = 2;
      gameMode = 1;
    }
    
    u8g.firstPage();
    do {switch (gameMode) {
          case 0:
            // Idling
            animationStepMax = 4;
            checkButton();
            // Icon frame
            u8g.drawXBMP(69, 1, speech_bubble_56x48_width, speech_bubble_56x48_height, speech_bubble_56x48_bits);
            // Icon (always happy)
            if (superHappyCounter<1) {
              u8g.drawXBMP(87, 12, happy_cat_28x28_width, happy_cat_28x28_height, happy_cat_28x28_bits);
            } else {
              u8g.drawXBMP(87, 12, super_happy_28x28_width, super_happy_28x28_height, super_happy_28x28_bits);
              superHappyCounter -= 1;
            }
            switch (animationStep) {
              case 1:
                // checkButton();
                u8g.drawXBMP(8, 8, cat_sitting_upscaled4x_001_width, cat_sitting_upscaled4x_001_height, cat_sitting_upscaled4x_001_bits);
                break;
              case 2:
                // checkButton();
                u8g.drawXBMP(8, 8, cat_sitting_upscaled4x_002_width, cat_sitting_upscaled4x_002_height, cat_sitting_upscaled4x_002_bits);
                break;
              case 3:
                // checkButton();
                u8g.drawXBMP(8, 8, cat_sitting_upscaled4x_003_width, cat_sitting_upscaled4x_003_height, cat_sitting_upscaled4x_003_bits);
                break;
              case 4:
                // checkButton();
                u8g.drawXBMP(8, 8, cat_sitting_upscaled4x_004_width, cat_sitting_upscaled4x_004_height, cat_sitting_upscaled4x_004_bits);
                break;
            }
            break;
          case 1:
            // Idle - looking left
            animationStepMax = 4;
            checkButton();
            // Icon frame
            u8g.drawXBMP(69, 1, speech_bubble_56x48_width, speech_bubble_56x48_height, speech_bubble_56x48_bits);
            // Icon (anything else than happy)
            switch (currentIcon) {
              case 2:
                // Play
                u8g.drawXBMP(85, 16, play_32x20_width, play_32x20_height, play_32x20_bits);
                break;
              case 3:
                // Study
                u8g.drawXBMP(88, 12, study_26x28_width, study_26x28_height, study_26x28_bits);
                break;
              case 5:
                // Bubbles
                u8g.drawXBMP(86, 11, bubbles_30x30_width, bubbles_30x30_height, bubbles_30x30_bits);
                break;
              case 6:
                // Pizza
                u8g.drawXBMP(88, 12, pizza_26x28_width, pizza_26x28_height, pizza_26x28_bits);
                break;
            }
            switch (animationStep) {
              case 1:
                checkButton();
                u8g.drawXBMP(8, 8, cat_sitting_upscaled4x_001_width, cat_sitting_upscaled4x_001_height, cat_sitting_upscaled4x_001_bits);
                break;
              case 2:
                checkButton();
                u8g.drawXBMP(8, 8, cat_sitting_upscaled4x_006_width, cat_sitting_upscaled4x_006_height, cat_sitting_upscaled4x_006_bits);
                break;
              case 3:
                checkButton();
                u8g.drawXBMP(8, 8, cat_sitting_upscaled4x_007_width, cat_sitting_upscaled4x_007_height, cat_sitting_upscaled4x_007_bits);
                break;
              case 4:
                checkButton();
                u8g.drawXBMP(8, 8, cat_sitting_upscaled4x_004_width, cat_sitting_upscaled4x_004_height, cat_sitting_upscaled4x_004_bits);
                break;
            }
            break;
          case 2:
            // Feed
            u8g.setFont(u8g2_font_ncenB08_tr);  // Adjust font as needed
            switch (feedSequence) {
              case 0:
                // Select food
                if (cat.strawberryFoodStock > 0) {
                  selectedFood = 1;
                  cat.strawberryFoodStock -= 1;
                } else if (cat.grapeFoodStock > 0) {
                  selectedFood = 2;
                  cat.grapeFoodStock -= 1;
                } else if (cat.milkFoodStock > 0) {
                  selectedFood = 3;
                  cat.milkFoodStock -= 1;
                } else if (cat.orangeFoodStock > 0) {
                  selectedFood = 4;
                  cat.orangeFoodStock -= 1;
                } else if (cat.appleFoodStock > 0) {
                  selectedFood = 5;
                  cat.appleFoodStock -= 1;
                } else {
                  selectedFood = 6;
                }
                cat.score += 20;
                feedSequence = 1;
                break;
              case 1:
                // Eat food
                switch (selectedFood) {
                  case 1:
                    u8g.drawXBMP(50, 14, strawberry_28x28_width, strawberry_28x28_height, strawberry_28x28_bits);
                    u8g.drawStr(10, 60, "Yummy strawberry");
                    break;
                  case 2:
                    u8g.drawXBMP(50, 14, grape_28x28_width, grape_28x28_height, grape_28x28_bits);
                    u8g.drawStr(30, 60, "Fresh grapes");
                    break;
                  case 3:
                    u8g.drawXBMP(50, 14, milk_28x28_width, milk_28x28_height, milk_28x28_bits);
                    u8g.drawStr(35, 60, "Farm milk");
                    break;
                  case 4:
                    u8g.drawXBMP(50, 14, orange_28x28_width, orange_28x28_height, orange_28x28_bits);
                    u8g.drawStr(30, 60, "Juicy orange");
                    break;
                  case 5:
                    u8g.drawXBMP(50, 14, apple_28x28_width, apple_28x28_height, apple_28x28_bits);
                    u8g.drawStr(35, 60, "Tasty apple");
                    break;
                  case 6:
                    u8g.drawXBMP(50, 14, ghost_28x28_width, ghost_28x28_height, ghost_28x28_bits);
                    u8g.drawStr(32, 60, "No food :-(");
                    break;
                }
                feedCounter += 1;
                if (feedCounter>shortWait) {
                  feedCounter = 0;
                  if (selectedFood != 6) {
                    feedSequence = 2;
                  } else {
                    gameCounter = 0;
                    gameSequence = 0;
                    currentReel = 0;
                    for (int i = 0; i < 3; i++) {
                      slotReel[i] = 0;
                      spinIcon[i] = 0;
                    }
                    gameMode = 6;
                  }
                }
                break;
              case 2:
                // Yum
                u8g.drawXBMP(-24, 13, cat_sitting_upscaled4x_001_width, cat_sitting_upscaled4x_001_height, cat_sitting_upscaled4x_001_bits);
                switch (selectedFood) {
                  case 1:
                    u8g.drawXBMP(50, 14, strawberry_28x28_width, strawberry_28x28_height, strawberry_28x28_bits);
                    break;
                  case 2:
                    u8g.drawXBMP(50, 14, grape_28x28_width, grape_28x28_height, grape_28x28_bits);
                    break;
                  case 3:
                    u8g.drawXBMP(50, 14, milk_28x28_width, milk_28x28_height, milk_28x28_bits);
                    break;
                  case 4:
                    u8g.drawXBMP(50, 14, orange_28x28_width, orange_28x28_height, orange_28x28_bits);
                    break;
                  case 5:
                    u8g.drawXBMP(50, 14, apple_28x28_width, apple_28x28_height, apple_28x28_bits);
                    break;
                }
                if (selectedFood != 6) {
                  u8g.drawStr(30, 60, "< Yum!");
                }
                feedCounter += 1;
                if (feedCounter>shortWait) {
                  feedCounter = 0;
                  if (selectedFood < 6) {
                    superHappyCounter = 100;
                    cat.hunger = 3;
                  }
                  gameMode = 0;
                }
                break;
            }
            break;
          case 4:
            // Educate
            switch (lessonSequence) {
              case 0:
                // Snail arrives
                u8g.drawXBMP(-24, 13, cat_sitting_upscaled4x_001_width, cat_sitting_upscaled4x_001_height, cat_sitting_upscaled4x_001_bits);
                u8g.drawXBMP(kokoXPos, 40, koko_le_snail_26x22_width, koko_le_snail_26x22_height, koko_le_snail_26x22_bits);
                kokoXPos -= 1;
                if (kokoXPos < 97) {
                  kokoXPos = 97;
                }
                snailCounter += 1;
                if (snailCounter>shortWait) {
                  snailCounter = 0;
                  lessonSequence = 1;
                }
                break;
              case 1:
                // Snail says hello
                u8g.setFont(u8g2_font_ncenB08_tr);  // Adjust font as needed
                u8g.drawXBMP(-24, 13, cat_sitting_upscaled4x_001_width, cat_sitting_upscaled4x_001_height, cat_sitting_upscaled4x_001_bits);
                u8g.drawXBMP(97, 40, koko_le_snail_26x22_width, koko_le_snail_26x22_height, koko_le_snail_26x22_bits);
                u8g.drawStr(70, 60, "Hi! >");
                snailCounter += 1;
                if (snailCounter>shortWait) {
                  snailCounter = 0;
                  lessonSequence = 2;
                }
                break;
              case 2:
                // Introduction
                u8g.drawLine(0, 8, 127, 8);
                u8g.drawLine(0, 56, 127, 56);
                u8g.setFont(u8g_font_baby);
                u8g.drawXBMP(97, 21, koko_le_snail_26x22_width, koko_le_snail_26x22_height, koko_le_snail_26x22_bits);
                u8g.drawStr(16, 18, "Get ready for a");
                u8g.drawStr(16, 24, "new lesson with...");
                u8g.drawStr(16, 30, "");
                u8g.drawStr(16, 36, "~ Koko Le Snail ~");
                snailCounter += 1;
                if (snailCounter>shortWait) {
                  snailCounter = 0;
                  lessonSequence = 3;
                }
                break;
              case 3:
                // Snail wisdom quote
                u8g.drawLine(0, 8, 127, 8);
                u8g.drawLine(0, 56, 127, 56);
                u8g.setFont(u8g_font_baby);
                u8g.drawXBMP(97, 21, koko_le_snail_26x22_width, koko_le_snail_26x22_height, koko_le_snail_26x22_bits);
                switch (randomQuote) {
                  case 1:
                    u8g.drawStr(16, 18, "Sometimes dogs");
                    u8g.drawStr(16, 24, "are grey.");
                    u8g.drawStr(16, 30, "");
                    u8g.drawStr(16, 36, "  -- Koko");
                    break;
                  case 2:
                    u8g.drawStr(16, 18, "Do not sneeze");
                    u8g.drawStr(16, 24, "on the bus.");
                    u8g.drawStr(16, 30, "");
                    u8g.drawStr(16, 36, "  -- Koko");
                    break;
                  case 3:
                    u8g.drawStr(16, 18, "Always wear");
                    u8g.drawStr(16, 24, "pants.");
                    u8g.drawStr(16, 30, "");
                    u8g.drawStr(16, 36, "  -- Koko");
                    break;
                  case 4:
                    u8g.drawStr(16, 18, "Never yawn");
                    u8g.drawStr(16, 24, "during class.");
                    u8g.drawStr(16, 30, "");
                    u8g.drawStr(16, 36, "  -- Koko");
                    break;
                  case 5:
                    u8g.drawStr(16, 18, "Wash your hands");
                    u8g.drawStr(16, 24, "after lunch.");
                    u8g.drawStr(16, 30, "");
                    u8g.drawStr(16, 36, "  -- Koko");
                    break;
                  case 6:
                    u8g.drawStr(16, 18, "Pull my finger...");
                    u8g.drawStr(16, 24, "teehee!");
                    u8g.drawStr(16, 30, "");
                    u8g.drawStr(16, 36, "  -- Koko");
                    break;
                }
                snailCounter += 1;
                if (snailCounter>mediumWait) {
                  snailCounter = 0;
                  lessonSequence = 4;
                }
                break;
              case 4:
                // Score
                u8g.setFont(u8g2_font_ncenB08_tr);  // Adjust font as needed
                u8g.drawXBMP(51, 12, study_26x28_width, study_26x28_height, study_26x28_bits);
                u8g.drawStr(20, 60, "  +1 Education ");
                snailCounter += 1;
                if (snailCounter>shortWait) {
                  snailCounter = 0;
                  superHappyCounter = 100;
                  cat.score += 100;
                  cat.education += 1;
                  gameMode = 0;
                }
                break;
            }
            break;
          case 5:
            // Clean
            switch (cleanSequence) {
              case 0:
                // Clean The Cat game
                u8g.drawXBMP(38, 8, cat_sitting_upscaled4x_001_width, cat_sitting_upscaled4x_001_height, cat_sitting_upscaled4x_001_bits);
                checkButton();
                cleanCounter -= 1;
                if (cleanCounter<(0 - longWait)) {
                  gameMode = 0;
                } else if (cleanCounter>100) {
                  cleanCounter = 0;
                  cleanSequence = 1;
                }
                switch(cleanCounter) {
                  case 5 ... 15:
                    u8g.drawXBMP(38, 32, bubbles_30x30_width, bubbles_30x30_height, bubbles_30x30_bits);
                    break;
                  case 16 ... 36:
                    u8g.drawXBMP(38, 32, bubbles_30x30_width, bubbles_30x30_height, bubbles_30x30_bits);
                    u8g.drawXBMP(58, 32, bubbles_30x30_width, bubbles_30x30_height, bubbles_30x30_bits);
                    break;
                  case 37 ... 57:
                    u8g.drawXBMP(23, 16, bubbles_30x30_width, bubbles_30x30_height, bubbles_30x30_bits);
                    u8g.drawXBMP(38, 32, bubbles_30x30_width, bubbles_30x30_height, bubbles_30x30_bits);
                    u8g.drawXBMP(58, 32, bubbles_30x30_width, bubbles_30x30_height, bubbles_30x30_bits);
                    u8g.drawXBMP(73, 16, bubbles_30x30_width, bubbles_30x30_height, bubbles_30x30_bits);
                    break;
                  case 58 ... 78:
                    u8g.drawXBMP(23, 16, bubbles_30x30_width, bubbles_30x30_height, bubbles_30x30_bits);
                    u8g.drawXBMP(38, 32, bubbles_30x30_width, bubbles_30x30_height, bubbles_30x30_bits);
                    u8g.drawXBMP(58, 32, bubbles_30x30_width, bubbles_30x30_height, bubbles_30x30_bits);
                    u8g.drawXBMP(73, 16, bubbles_30x30_width, bubbles_30x30_height, bubbles_30x30_bits);
                    u8g.drawXBMP(32, 0, bubbles_30x30_width, bubbles_30x30_height, bubbles_30x30_bits);
                    u8g.drawXBMP(64, 0, bubbles_30x30_width, bubbles_30x30_height, bubbles_30x30_bits);
                    break;
                  case 79 ... 89:
                    u8g.drawXBMP(23, 16, bubbles_30x30_width, bubbles_30x30_height, bubbles_30x30_bits);
                    u8g.drawXBMP(38, 32, bubbles_30x30_width, bubbles_30x30_height, bubbles_30x30_bits);
                    u8g.drawXBMP(58, 32, bubbles_30x30_width, bubbles_30x30_height, bubbles_30x30_bits);
                    u8g.drawXBMP(73, 16, bubbles_30x30_width, bubbles_30x30_height, bubbles_30x30_bits);
                    u8g.drawXBMP(0, 32, bubbles_30x30_width, bubbles_30x30_height, bubbles_30x30_bits);
                    u8g.drawXBMP(32, 0, bubbles_30x30_width, bubbles_30x30_height, bubbles_30x30_bits);
                    u8g.drawXBMP(64, 0, bubbles_30x30_width, bubbles_30x30_height, bubbles_30x30_bits);
                    u8g.drawXBMP(96, 32, bubbles_30x30_width, bubbles_30x30_height, bubbles_30x30_bits);
                    break;
                  case 90 ... 100:
                    u8g.drawXBMP(0, 0, bubbles_30x30_width, bubbles_30x30_height, bubbles_30x30_bits);
                    u8g.drawXBMP(32, 0, bubbles_30x30_width, bubbles_30x30_height, bubbles_30x30_bits);
                    u8g.drawXBMP(64, 0, bubbles_30x30_width, bubbles_30x30_height, bubbles_30x30_bits);
                    u8g.drawXBMP(96, 0, bubbles_30x30_width, bubbles_30x30_height, bubbles_30x30_bits);
                    u8g.drawXBMP(0, 32, bubbles_30x30_width, bubbles_30x30_height, bubbles_30x30_bits);
                    u8g.drawXBMP(32, 32, bubbles_30x30_width, bubbles_30x30_height, bubbles_30x30_bits);
                    u8g.drawXBMP(64, 32, bubbles_30x30_width, bubbles_30x30_height, bubbles_30x30_bits);
                    u8g.drawXBMP(96, 32, bubbles_30x30_width, bubbles_30x30_height, bubbles_30x30_bits);
                }
                break;
              case 1:
                u8g.drawXBMP(-24, 13, cat_sitting_upscaled4x_001_width, cat_sitting_upscaled4x_001_height, cat_sitting_upscaled4x_001_bits);
                u8g.setFont(u8g2_font_ncenB08_tr);  // Adjust font as needed
                u8g.drawStr(50, 21, "All clean!!!");
                cleanCounter += 1;
                if (cleanCounter>shortWait) {
                  cleanCounter = 0;
                  superHappyCounter = 100;
                  cat.score += 200;
                  cat.hygiene = 3;
                  gameMode = 0;
                }
                break;
            }
            break;
          case 6:
            // Play Catsino Deluxe
            if (gameSequence == 0) {
              // Spin the reels
              checkButton();
              animationStepMax = 7;
              u8g.setFont(u8g_font_baby);
              u8g.drawStr(13, 6, "xxxx Catsino Deluxe xxxx");
              u8g.drawXBMP(3, 18, casino_frame_40x40_width, casino_frame_40x40_height, casino_frame_40x40_bits);
              u8g.drawXBMP(44, 18, casino_frame_40x40_width, casino_frame_40x40_height, casino_frame_40x40_bits);
              u8g.drawXBMP(85, 18, casino_frame_40x40_width, casino_frame_40x40_height, casino_frame_40x40_bits);
              int reelX[3] = {9, 50, 91};
              for (int i = 0; i < 3; i++) {
                if (i < currentReel) {
                  switch (slotReel[i]) {
                    case 0:
                      u8g.drawXBMP(reelX[i], 24, ghost_28x28_width, ghost_28x28_height, ghost_28x28_bits);
                      break;
                    case 1:
                      u8g.drawXBMP(reelX[i], 24, bar_28x28_width, bar_28x28_height, bar_28x28_bits);
                      break;
                    case 2:
                      u8g.drawXBMP(reelX[i], 24, strawberry_28x28_width, strawberry_28x28_height, strawberry_28x28_bits);
                      break;
                    case 3:
                      u8g.drawXBMP(reelX[i], 24, apple_28x28_width, apple_28x28_height, apple_28x28_bits);
                      break;
                    case 4:
                      u8g.drawXBMP(reelX[i], 24, grape_28x28_width, grape_28x28_height, grape_28x28_bits);
                      break;
                    case 5:
                      u8g.drawXBMP(reelX[i], 24, milk_28x28_width, milk_28x28_height, milk_28x28_bits);
                      break;
                    case 6:
                      u8g.drawXBMP(reelX[i], 24, orange_28x28_width, orange_28x28_height, orange_28x28_bits);
                      break;
                  }
                } else {
                  spinIcon[i] = random(0,7);
                  switch (spinIcon[i]) {
                    case 0:
                      u8g.drawXBMP(reelX[i], 24, ghost_28x28_width, ghost_28x28_height, ghost_28x28_bits);
                      break;
                    case 1:
                      u8g.drawXBMP(reelX[i], 24, bar_28x28_width, bar_28x28_height, bar_28x28_bits);
                      break;
                    case 2:
                      u8g.drawXBMP(reelX[i], 24, strawberry_28x28_width, strawberry_28x28_height, strawberry_28x28_bits);
                      break;
                    case 3:
                      u8g.drawXBMP(reelX[i], 24, apple_28x28_width, apple_28x28_height, apple_28x28_bits);
                      break;
                    case 4:
                      u8g.drawXBMP(reelX[i], 24, grape_28x28_width, grape_28x28_height, grape_28x28_bits);
                      break;
                    case 5:
                      u8g.drawXBMP(reelX[i], 24, milk_28x28_width, milk_28x28_height, milk_28x28_bits);
                      break;
                    case 6:
                      u8g.drawXBMP(reelX[i], 24, orange_28x28_width, orange_28x28_height, orange_28x28_bits);
                      break;
                  }
                }
              }
              gameCounter += 1;
              // Safety timeout
              if (gameCounter>longWait) {
                gameCounter = 0;
                gameMode = 0;
                currentReel = 0;
              }
            } else if (gameSequence == 1) {
              // Random food item chance selection
              u8g.setFont(u8g_font_baby);
              u8g.drawStr(12, 6, "### Lucky Food Time ###");
              switch(gameCounter) {
                case 0:
                  u8g.drawXBMP(3, 18, casino_frame_40x40_width, casino_frame_40x40_height, casino_frame_40x40_bits);
                  break;
                case 1:
                  u8g.drawXBMP(44, 18, casino_frame_40x40_width, casino_frame_40x40_height, casino_frame_40x40_bits);
                  break;
                case 2:
                  u8g.drawXBMP(85, 18, casino_frame_40x40_width, casino_frame_40x40_height, casino_frame_40x40_bits);
                  gameCounter = -1;
                  break;
              }
              gameCounter += 1;
              if (gameCounter > 3) {
                gameCounter = 0;
              }
              int reelX[3] = {9, 50, 91};
              for (int i = 0; i < 3; i++) {
                mysteryFood = slotReel[i];
                checkButton();
                switch (slotReel[i]) {
                  case 0:
                    u8g.drawXBMP(reelX[i], 24, ghost_28x28_width, ghost_28x28_height, ghost_28x28_bits);
                    break;
                  case 1:
                    u8g.drawXBMP(reelX[i], 24, bar_28x28_width, bar_28x28_height, bar_28x28_bits);
                    break;
                  case 2:
                    u8g.drawXBMP(reelX[i], 24, strawberry_28x28_width, strawberry_28x28_height, strawberry_28x28_bits);
                    break;
                  case 3:
                    u8g.drawXBMP(reelX[i], 24, apple_28x28_width, apple_28x28_height, apple_28x28_bits);
                    break;
                  case 4:
                    u8g.drawXBMP(reelX[i], 24, grape_28x28_width, grape_28x28_height, grape_28x28_bits);
                    break;
                  case 5:
                    u8g.drawXBMP(reelX[i], 24, milk_28x28_width, milk_28x28_height, milk_28x28_bits);
                    break;
                  case 6:
                    u8g.drawXBMP(reelX[i], 24, orange_28x28_width, orange_28x28_height, orange_28x28_bits);
                    break;
                }
              }
            } else if (gameSequence == 2) {
              // See the result: debrief dialog (wait for button)
              const char* resultText = "No match";
              int resultIcon = 0;
              switch (gamePick) {
                case 0:
                  resultText = "Nothing, boo!";
                  resultIcon = 0;
                  break;
                case 1:
                  resultText = "+1 of all!";
                  resultIcon = 1;
                  break;
                case 2:
                  resultText = "+1 strawberry";
                  resultIcon = 2;
                  break;
                case 3:
                  resultText = "+1 apple";
                  resultIcon = 3;
                  break;
                case 4:
                  resultText = "+1 grape";
                  resultIcon = 4;
                  break;
                case 5:
                  resultText = "+1 milk";
                  resultIcon = 5;
                  break;
                case 6:
                  resultText = "+1 orange";
                  resultIcon = 6;
                  break;
                case 7:
                  resultText = "Disaster...";
                  resultIcon = 0;
                  break;
                case 8:
                  resultText = "+30 of all!";
                  resultIcon = 1;
                  break;
                case 9:
                  resultText = "Superbonus!";
                  resultIcon = 7;
                  break;
              }
              drawDialog(0, resultText, "Press button to continue", resultIcon);
            }
            break;
          case 7:
            // Random visitor
            u8g.setFont(u8g_font_baby);
            switch (randomVisitSequence) {
              case 0:
                // Knock
                checkButton();
                u8g.drawXBMP(50, 14, door_28x30_width, door_28x30_height, door_28x30_bits);
                u8g.drawStr(40, 60, "Knock knock!");
                randomVisitCounter += 1;
                if (randomVisitCounter>longWait) {
                  randomVisitSequence = 1;
                  randomVisitCounter = 0;
                }
                break;
              case 1:
                // Hello
                u8g.drawXBMP(-24, 13, cat_sitting_upscaled4x_001_width, cat_sitting_upscaled4x_001_height, cat_sitting_upscaled4x_001_bits);
                u8g.drawXBMP(96, 14, cindy_28x26_width, cindy_28x26_height, cindy_28x26_bits);
                u8g.drawStr(45, 60, "Hi friend!");
                randomVisitCounter += 1;
                if (randomVisitCounter>shortWait) {
                  randomVisitSequence = 2;
                  randomVisitCounter = 0;
                }
                break;
              case 2:
                // Gift
                u8g.drawXBMP(-24, 13, cat_sitting_upscaled4x_001_width, cat_sitting_upscaled4x_001_height, cat_sitting_upscaled4x_001_bits);
                u8g.drawXBMP(96, 14, cindy_28x26_width, cindy_28x26_height, cindy_28x26_bits);
                if (randomVisit<100) {
                  // Matcha
                  u8g.drawStr(45, 60, "I got matcha tea!");
                } else {
                  u8g.drawStr(45, 60, "I got coco cake!");
                }
                randomVisitCounter += 1;
                if (randomVisitCounter>shortWait) {
                  randomVisitSequence = 3;
                  randomVisitCounter = 0;
                }
                break;
              case 3:
                // Drink
                u8g.drawXBMP(-24, 13, cat_sitting_upscaled4x_001_width, cat_sitting_upscaled4x_001_height, cat_sitting_upscaled4x_001_bits);
                if (randomVisit<100) {
                  // Matcha
                  u8g.drawXBMP(49, 14, matcha_30x32_width, matcha_30x32_height, matcha_30x32_bits);
                } else {
                  u8g.drawXBMP(49, 14, coco_cake_28x32_width, coco_cake_28x32_height, coco_cake_28x32_bits);
                }
                u8g.drawXBMP(96, 14, cindy_28x26_width, cindy_28x26_height, cindy_28x26_bits);
                u8g.drawStr(45, 60, "Have some <3");
                randomVisitCounter += 1;
                if (randomVisitCounter>shortWait) {
                  randomVisitSequence = 4;
                  randomVisitCounter = 0;
                }
                break;
              case 4:
                // Bonus
                u8g.setFont(u8g2_font_ncenB08_tr);  // Adjust font as needed
                if (randomVisit<100) {
                  // Matcha
                  u8g.drawXBMP(49, 14, matcha_30x32_width, matcha_30x32_height, matcha_30x32_bits);
                } else {
                  u8g.drawXBMP(49, 14, coco_cake_28x32_width, coco_cake_28x32_height, coco_cake_28x32_bits);
                }
                u8g.drawStr(50, 60, "Yum!");
                randomVisitCounter += 1;
                if (randomVisitCounter>shortWait) {
                  randomVisitSequence = 0;
                  randomVisitCounter = 0;
                  superHappyCounter = 100;
                  cat.score += 10000;
                  cat.hunger = 3;
                  gameMode = 0;
                }
                break;
            }
            break;
          case 8:
            // Save
            if (gameSequence == 0) {
              u8g.setFont(u8g_font_baby);
              u8g.drawStr(13, 6, "xxxx Save game xxxx");
              u8g.drawStr(13, 18, "Press button for YES");
              u8g.drawStr(13, 24, "Wait for NO");
              gameCounter += 1;
              if (gameCounter>shortWait) {
                gameCounter = 0;
                gameMode = 0;
              }
              checkButton();
            } else if (gameSequence == 1) {
              saveStatsToEEPROM();
              gameCounter = 0;
              gameSequence = 2;
            } else if (gameSequence == 2) {
              u8g.drawStr(13, 24, "[OK] Game saved");
              gameCounter += 1;
              if (gameCounter>shortWait) {
                gameCounter = 0;
                gameMode = 0;
              }
            }
            break;
          case 99:
            // Show version
            u8g.setFont(u8g2_font_ncenB08_tr);  // Adjust font as needed
            u8g.drawStr(0, 34, "        TiMiNoo 1.4.1");
            checkButton();
            versionCounter += 1;
            if (versionCounter>shortWait) {
              gameMode = 0;
              versionCounter = 0;
              loadStatsFromEEPROM();
            }
            break;
        }
        if (gameMode < 2) {
          // Score
          u8g.setFont(u8g_font_baby);
          ultoa(cat.score, scoreString, 10);
          u8g.drawStr(81, 60, scoreString);
        }
      } while (u8g.nextPage());
    }
  }
